## Documentation/devicetree/bindings/display/panel/ontat,kd50g21-18b.txt
```
On Tat Industrial Company 5" DPI TFT panel (18 Bit Color).

Required properties:
- compatible: should be "ontat,kd50g21-18b"

This binding is compatible with the simple-panel binding, which is specified
in simple-panel.txt in this directory.
```

## Documentation/devicetree/bindings/display/panel/ontat,kd50g21-24b.txt
```
On Tat Industrial Company 5" DPI TFT panel (24 Bit Color).

Required properties:
- compatible: should be "ontat,kd50g21-24b"

This binding is compatible with the simple-panel binding, which is specified
in simple-panel.txt in this directory.
```
